## main/Kconfig
```kconfig
menu "Project Configuration"

    config WIFI_SSID
        string "WiFi SSID"
        default "myssid"
        help
            WiFi SSID (network name) to connect to.

    config WIFI_PASSWORD
        string "WiFi Password"
        default "mypassword"
        help
            WiFi password (WPA or WPA2) of network.

    config NTP_SERVER_1
        string "NTP Server 1"
        default "0.pool.ntp.org"
        help
            First NTP server to use.
            
    config NTP_SERVER_2
        string "NTP Server 2"
        default "1.pool.ntp.org"
        help
            Second NTP server to use.

    config LOCAL_TIMEZONE
        string "Local timezone"
        default "MST7MDT,M3.2.0,M11.1.0"
        help
            Local timezone in POSIX format.
endmenu
```

## sdkconfig.defaults
```kconfig
CONFIG_LWIP_DHCP_MAX_NTP_SERVERS=2
CONFIG_ESP_MAIN_TASK_STACK_SIZE=8192
CONFIG_ESPTOOLPY_FLASHSIZE_4MB=y
CONFIG_PARTITION_TABLE_CUSTOM=y
CONFIG_PARTITION_TABLE_CUSTOM_FILENAME="partition_table.csv"
CONFIG_SPIFFS_META_LENGTH=1
CONFIG_SPIFFS_USE_DIR=y
```
